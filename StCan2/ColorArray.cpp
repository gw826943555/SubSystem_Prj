#include "ColorArray.hpp"

//unsigned char SinTab[STEP_NUM + 1] =
//{
//	0x0, 0x0, 0x0, 0x0, 0x0, 0x0, 0x0, 0x0, 0x0, 0x0, 0x0, 0x0, 0x1, 0x1, 0x1, 0x1,
//	0x1, 0x1, 0x1, 0x1, 0x2, 0x2, 0x2, 0x2, 0x2, 0x2, 0x3, 0x3, 0x3, 0x3, 0x3, 0x4,
//	0x4, 0x4, 0x4, 0x5, 0x5, 0x5, 0x5, 0x6, 0x6, 0x6, 0x7, 0x7, 0x7, 0x7, 0x8, 0x8,
//	0x8, 0x9, 0x9, 0xa, 0xa, 0xa, 0xb, 0xb, 0xb, 0xc, 0xc, 0xd, 0xd, 0xd, 0xe, 0xe,
//	0xf, 0xf, 0x10, 0x10, 0x11, 0x11, 0x11, 0x12, 0x12, 0x13, 0x13, 0x14, 0x14, 0x15, 0x15, 0x16,
//	0x16, 0x17, 0x17, 0x18, 0x18, 0x19, 0x1a, 0x1a, 0x1b, 0x1b, 0x1c, 0x1c, 0x1d, 0x1d, 0x1e, 0x1f,
//	0x1f, 0x20, 0x20, 0x21, 0x21, 0x22, 0x23, 0x23, 0x24, 0x24, 0x25, 0x26, 0x26, 0x27, 0x27, 0x28,
//	0x29, 0x29, 0x2a, 0x2a, 0x2b, 0x2c, 0x2c, 0x2d, 0x2d, 0x2e, 0x2f, 0x2f, 0x30, 0x30, 0x31, 0x32,
//	0x32, 0x33, 0x34, 0x34, 0x35, 0x35, 0x36, 0x37, 0x37, 0x38, 0x38, 0x39, 0x3a, 0x3a, 0x3b, 0x3b,
//	0x3c, 0x3d, 0x3d, 0x3e, 0x3e, 0x3f, 0x40, 0x40, 0x41, 0x41, 0x42, 0x43, 0x43, 0x44, 0x44, 0x45,
//	0x45, 0x46, 0x47, 0x47, 0x48, 0x48, 0x49, 0x49, 0x4a, 0x4a, 0x4b, 0x4c, 0x4c, 0x4d, 0x4d, 0x4e,
//	0x4e, 0x4f, 0x4f, 0x50, 0x50, 0x51, 0x51, 0x52, 0x52, 0x53, 0x53, 0x53, 0x54, 0x54, 0x55, 0x55,
//	0x56, 0x56, 0x57, 0x57, 0x57, 0x58, 0x58, 0x59, 0x59, 0x59, 0x5a, 0x5a, 0x5a, 0x5b, 0x5b, 0x5c,
//	0x5c, 0x5c, 0x5d, 0x5d, 0x5d, 0x5d, 0x5e, 0x5e, 0x5e, 0x5f, 0x5f, 0x5f, 0x5f, 0x60, 0x60, 0x60,
//	0x60, 0x61, 0x61, 0x61, 0x61, 0x61, 0x62, 0x62, 0x62, 0x62, 0x62, 0x62, 0x63, 0x63, 0x63, 0x63,
//	0x63, 0x63, 0x63, 0x63, 0x64, 0x64, 0x64, 0x64, 0x64, 0x64, 0x64, 0x64, 0x64, 0x64, 0x64, 0x64
//};

void ColorArray::set_normal_command(emode t, int max, int param, int r, int g, int b)
{
	switch (t)
	{
	case powerOn:
		cal_power_on(max);
		break;
	case battery:
		cal_battery_display(param,max);
		break;
	case alert:
		cal_alert(max);
		break;
	case specified:
		set_color_array(NUM_LED,r,g,b);
		break;
	default:
		return;
	}
	update();
}

void ColorArray::update()
{
	int row = 0;
	for (int i = 0; i < m_len; ++i)
	{

		for (int j = 0; j < 8; ++j)
		{
			p_bin_array[row + j] = PWM_LOW +
				(PWM_HIGH - PWM_LOW)*((p_color_array[i] >> (7 - j)) & 0x01);
		}
		row += 8;
	}
}

void ColorArray::cal_power_on(int maxIntensity)
{
	static int ct_poweron = 0;
	static int dir_poweron = 0;

	set_color_array(NUM_LED,0,0,ct_poweron);//blue
	judge(ct_poweron, dir_poweron,maxIntensity);
}

void ColorArray::cal_alert(int maxIntensity)
{
	static int ct_alert = 0;
	static int dir_alert = 0;
	set_color_array(NUM_LED,ct_alert,0,0);//red
	judge(ct_alert, dir_alert,maxIntensity);	
}

void ColorArray::cal_battery_display(int param, int max)
{
	set_color_array(NUM_LED,(100 - param) * max / 100.0 ,param * max / 100.0 ,0);//red
}

void ColorArray::set_color_array(int num, int r, int g, int b)
{
	int temp_num = num > NUM_LED ? NUM_LED : num;
	int temp = 0;
	for (int i = 0; i < temp_num; ++i)
	{
		p_color_array[temp] = g;
		p_color_array[temp + 1] = r;
		p_color_array[temp + 2] = b;
		temp += COLOR_BASE;
	}
	for (int i = temp_num; i < NUM_LED; ++i)
	{
		p_color_array[temp] = 0;
		p_color_array[temp + 1] = 0;
		p_color_array[temp + 2] = 0;
		temp += COLOR_BASE;
	}
}

void ColorArray::judge(int& counter, int& direction, int max)
{
	if (0 == direction)
	{
		if (++counter >= max) direction = 1;
	}
	else
	{
		if (--counter <= 0) direction = 0;
	}
}
ColorArray* ColorArray::m_pInstance = NULL;

void CSingleton::Test()
{
	return ;
}

CSingleton *CSingleton::m_pInstance=NULL;
